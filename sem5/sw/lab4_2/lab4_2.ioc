# file: lab4_2.ioc
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Mcu.Family=STM32L4
Mcu.Name=STM32L496Z(E-G)Tx
Mcu.Package=LQFP144
NVIC.PriorityGroup=NVIC_PRIORITYGROUP_4
NVIC.TIM2_IRQn=true\:0\:0\:false\:false\:true\:true\:true\:true
ProjectManager.HeapSize=0x200
ProjectManager.StackSize=0x400
ProjectManager.TargetToolchain=STM32CubeIDE
RCC.ADCFreq_Value=16000000
RCC.AHBFreq_Value=32000000
RCC.APB1Freq_Value=32000000
RCC.APB1TimFreq_Value=32000000
RCC.APB2Freq_Value=32000000
RCC.APB2TimFreq_Value=32000000
RCC.CortexFreq_Value=32000000
RCC.HCLKFreq_Value=32000000
RCC.HSE_VALUE=8000000
RCC.HSI48_VALUE=48000000
RCC.HSI_VALUE=16000000
RCC.LSE_VALUE=32768
RCC.MSI_VALUE=4000000
RCC.PLLN=16
RCC.SYSCLKFreq_VALUE=32000000
RCC.SYSCLKSource=RCC_SYSCLKSOURCE_PLLCLK
RCC.USBFreq_Value=16000000
RCC.VCOOutputFreq_Value=64000000
TIM2.AutoReloadPreload=TIM_AUTORELOAD_PRELOAD_DISABLE
TIM2.Period=1
TIM2.Prescaler=1599
VP_TIM2_VS_ClockSourceINT.Mode=Internal
board=custom

// file: Core/Src/main.c
/* USER CODE BEGIN Header */
/**
  ******************************************************************************
  * @file           : main.c
  * @brief          : Main program body
  ******************************************************************************
  * @attention
  *
  * Copyright (c) 2023 STMicroelectronics.
  * All rights reserved.
  *
  * This software is licensed under terms that can be found in the LICENSE file
  * in the root directory of this software component.
  * If no LICENSE file comes with this software, it is provided AS-IS.
  *
  ******************************************************************************
  */
/* USER CODE END Header */
#include "main.h"

/* USER CODE BEGIN PTD */
typedef enum
{
	MINUTES_SECONDS,
	HOURS_MINUTES
} ClockModeType;
/* USER CODE END PTD */

/* USER CODE BEGIN PD */

#define JOY_PORT GPIOE
#define JOY_PORT_PUSH GPIO_PIN_15
#define IS_JOY_PUSH ((~(GPIOE->IDR) & JOY_PORT_PUSH) ? 1 : 0)

#define SEGMENT_A_PIN  GPIO_PIN_0
#define SEGMENT_B_PIN  GPIO_PIN_1
#define SEGMENT_C_PIN  GPIO_PIN_2
#define SEGMENT_D_PIN  GPIO_PIN_3
#define SEGMENT_E_PIN  GPIO_PIN_4
#define SEGMENT_F_PIN  GPIO_PIN_5
#define SEGMENT_G_PIN  GPIO_PIN_6
#define SEGMENT_DP_PIN GPIO_PIN_9

#define SEGMENT_GPIO_PORT GPIOG
#define SEGMENT_MASK SEGMENT_A_PIN | SEGMENT_B_PIN | SEGMENT_C_PIN | SEGMENT_D_PIN | SEGMENT_E_PIN | SEGMENT_F_PIN | SEGMENT_G_PIN | SEGMENT_DP_PIN

#define DIGIT_1_PIN GPIO_PIN_2
#define DIGIT_2_PIN GPIO_PIN_3
#define DIGIT_3_PIN GPIO_PIN_4
#define DIGIT_4_PIN GPIO_PIN_5

#define DIGIT_GPIO_PORT GPIOB
#define DIGIT_MASK DIG1_PIN | DIG2_PIN | DIG3_PIN | DIG4_PIN

#define FREQ 50U // 50 Hz
#define DELAY 20U // 20 ms
#define MAX_HOURS 24U
#define MAX_MINUTES_SECONDS 60U
#define MAX_MILISECONDS 1000U
#define RIGHT_DOT_BLINK_INTERVAL 2000U
#define NUMBER_OF_DIGITS 4U

/* USER CODE END PD */

TIM_HandleTypeDef htim2;

/* USER CODE BEGIN PV */
TIM_HandleTypeDef htim2;

const uint8_t segments_au8[] = {
    SEGMENT_A_PIN | SEGMENT_B_PIN | SEGMENT_C_PIN | SEGMENT_D_PIN | SEGMENT_E_PIN | SEGMENT_F_PIN,                 // 0
    SEGMENT_B_PIN | SEGMENT_C_PIN,                                                                                 // 1
	SEGMENT_A_PIN | SEGMENT_E_PIN | SEGMENT_B_PIN | SEGMENT_D_PIN | SEGMENT_G_PIN,                                 // 2
	SEGMENT_A_PIN | SEGMENT_B_PIN | SEGMENT_G_PIN | SEGMENT_C_PIN | SEGMENT_D_PIN,                                 // 3
	SEGMENT_F_PIN | SEGMENT_G_PIN | SEGMENT_B_PIN | SEGMENT_C_PIN,                                                 // 4
	SEGMENT_A_PIN | SEGMENT_F_PIN | SEGMENT_G_PIN | SEGMENT_C_PIN | SEGMENT_D_PIN,                                 // 5
    SEGMENT_A_PIN | SEGMENT_F_PIN | SEGMENT_G_PIN | SEGMENT_E_PIN | SEGMENT_C_PIN | SEGMENT_D_PIN,                 // 6
	SEGMENT_A_PIN | SEGMENT_B_PIN | SEGMENT_C_PIN,                                                                 // 7
    SEGMENT_A_PIN | SEGMENT_B_PIN | SEGMENT_C_PIN | SEGMENT_D_PIN | SEGMENT_E_PIN | SEGMENT_F_PIN | SEGMENT_G_PIN, // 8
	SEGMENT_A_PIN | SEGMENT_B_PIN | SEGMENT_C_PIN | SEGMENT_D_PIN | SEGMENT_F_PIN | SEGMENT_G_PIN                  // 9
};

uint16_t miliseconds_u16 = 0U;
uint16_t dotBlinkCounter_u16 = 0U;
uint8_t seconds_u8 = 0U;
uint8_t minutes_u8 = 0U;
uint8_t hours_u8 = 0U;
ClockModeType clockMode_e = MINUTES_SECONDS;
/* USER CODE END PV */

void SystemClock_Config(void);
static void MX_TIM2_Init(void);

int main(void)
{

  /* MCU Configuration--------------------------------------------------------*/

  /* Reset of all peripherals, Initializes the Flash interface and the Systick. */
  HAL_Init();

  /* Configure the system clock */
  SystemClock_Config();

  /* Initialize all configured peripherals */
  MX_TIM2_Init();
  /* USER CODE BEGIN 2 */
  HAL_TIM_Base_Start_IT(&htim2);
  /* USER CODE END 2 */

  /* Infinite loop */
  while (1)
  {

  }
}

void SystemClock_Config(void)
{
  RCC_OscInitTypeDef RCC_OscInitStruct = {0};
  RCC_ClkInitTypeDef RCC_ClkInitStruct = {0};

  /** Configure the main internal regulator output voltage
  */
  if (HAL_PWREx_ControlVoltageScaling(PWR_REGULATOR_VOLTAGE_SCALE1) != HAL_OK)
  {
    Error_Handler();
  }

  /** Initializes the RCC Oscillators according to the specified parameters
  * in the RCC_OscInitTypeDef structure.
  */
  RCC_OscInitStruct.OscillatorType = RCC_OSCILLATORTYPE_MSI;
  RCC_OscInitStruct.MSIState = RCC_MSI_ON;
  RCC_OscInitStruct.MSICalibrationValue = 0;
  RCC_OscInitStruct.MSIClockRange = RCC_MSIRANGE_6;
  RCC_OscInitStruct.PLL.PLLState = RCC_PLL_ON;
  RCC_OscInitStruct.PLL.PLLSource = RCC_PLLSOURCE_MSI;
  RCC_OscInitStruct.PLL.PLLM = 1;
  RCC_OscInitStruct.PLL.PLLN = 16;
  RCC_OscInitStruct.PLL.PLLP = RCC_PLLP_DIV2;
  RCC_OscInitStruct.PLL.PLLQ = RCC_PLLQ_DIV2;
  RCC_OscInitStruct.PLL.PLLR = RCC_PLLR_DIV2;
  if (HAL_RCC_OscConfig(&RCC_OscInitStruct) != HAL_OK)
  {
    Error_Handler();
  }

  /** Initializes the CPU, AHB and APB buses clocks
  */
  RCC_ClkInitStruct.ClockType = RCC_CLOCKTYPE_HCLK|RCC_CLOCKTYPE_SYSCLK
                              |RCC_CLOCKTYPE_PCLK1|RCC_CLOCKTYPE_PCLK2;
  RCC_ClkInitStruct.SYSCLKSource = RCC_SYSCLKSOURCE_PLLCLK;
  RCC_ClkInitStruct.AHBCLKDivider = RCC_SYSCLK_DIV1;
  RCC_ClkInitStruct.APB1CLKDivider = RCC_HCLK_DIV1;
  RCC_ClkInitStruct.APB2CLKDivider = RCC_HCLK_DIV1;

  if (HAL_RCC_ClockConfig(&RCC_ClkInitStruct, FLASH_LATENCY_1) != HAL_OK)
  {
    Error_Handler();
  }
}

static void MX_TIM2_Init(void)
{

  TIM_ClockConfigTypeDef sClockSourceConfig = {0};
  TIM_MasterConfigTypeDef sMasterConfig = {0};

  htim2.Instance = TIM2;
  htim2.Init.Prescaler = 1599;
  htim2.Init.CounterMode = TIM_COUNTERMODE_UP;
  htim2.Init.Period = 1;
  htim2.Init.ClockDivision = TIM_CLOCKDIVISION_DIV1;
  htim2.Init.AutoReloadPreload = TIM_AUTORELOAD_PRELOAD_DISABLE;
  if (HAL_TIM_Base_Init(&htim2) != HAL_OK)
  {
    Error_Handler();
  }
  sClockSourceConfig.ClockSource = TIM_CLOCKSOURCE_INTERNAL;
  if (HAL_TIM_ConfigClockSource(&htim2, &sClockSourceConfig) != HAL_OK)
  {
    Error_Handler();
  }
  sMasterConfig.MasterOutputTrigger = TIM_TRGO_RESET;
  sMasterConfig.MasterSlaveMode = TIM_MASTERSLAVEMODE_DISABLE;
  if (HAL_TIMEx_MasterConfigSynchronization(&htim2, &sMasterConfig) != HAL_OK)
  {
    Error_Handler();
  }

}

/* USER CODE BEGIN 4 */

void HAL_TIM_PeriodElapsedCallback(TIM_HandleTypeDef *htim)
{
	  static uint8_t previousCycleJoyPush_u8 = 0U;
	  static uint8_t currentDigit_u8 = 0U;

	  miliseconds_u16++;

	  if (miliseconds_u16 >= MAX_MILISECONDS)
	  {
		  miliseconds_u16 -= MAX_MILISECONDS;
		  seconds_u8++;
	  }

	  if (seconds_u8 >= MAX_MINUTES_SECONDS)
	  {
		  seconds_u8 = 0U;
		  minutes_u8++;
	  }

	  if (minutes_u8 >= MAX_MINUTES_SECONDS)
	  {
		  minutes_u8 = 0U;
		  hours_u8++;
	  }

	  if (hours_u8 >= MAX_HOURS)
	  {
		  miliseconds_u16 = 0U;
		  seconds_u8 = 0U;
		  minutes_u8 = 0U;
		  hours_u8 = 0U;
	  }

	  if (IS_JOY_PUSH)
	  {
		  if (0U == previousCycleJoyPush_u8)
		  {
			  if (MINUTES_SECONDS == clockMode_e)
			  {
				  clockMode_e = HOURS_MINUTES;
			  }
			  else
			  {
				  clockMode_e = MINUTES_SECONDS;

				  /* On switching to minutes:seconds, right dot should be switched off
				   * and the counter should be reset. */
				  dotBlinkCounter_u16 = 0U;
			  }

			  previousCycleJoyPush_u8 = 1U;
		  }
	  }
	  else
	  {
		  previousCycleJoyPush_u8 = 0U;
	  }

	  /* minutes:seconds */
	  if (MINUTES_SECONDS == clockMode_e)
	  {
		  // Digit 1
		  if (0U == currentDigit_u8)
		  {
			  uint8_t minutesDigitLeft_u8 = (uint8_t)((float)minutes_u8 / 10.0F);

			  HAL_GPIO_WritePin(SEGMENT_GPIO_PORT, SEGMENT_MASK, GPIO_PIN_RESET);
			  HAL_GPIO_WritePin(DIGIT_GPIO_PORT, DIGIT_4_PIN, GPIO_PIN_RESET);
			  HAL_GPIO_WritePin(SEGMENT_GPIO_PORT, segments_au8[minutesDigitLeft_u8], GPIO_PIN_SET);
			  HAL_GPIO_WritePin(DIGIT_GPIO_PORT, DIGIT_1_PIN, GPIO_PIN_SET);
		  }

		  // Digit 2
		  if (1U == currentDigit_u8)
		  {
			  uint8_t minutesDigitRight_u8 = minutes_u8 % 10U;

			  HAL_GPIO_WritePin(SEGMENT_GPIO_PORT, SEGMENT_MASK, GPIO_PIN_RESET);
			  HAL_GPIO_WritePin(DIGIT_GPIO_PORT, DIGIT_1_PIN, GPIO_PIN_RESET);
			  HAL_GPIO_WritePin(SEGMENT_GPIO_PORT, segments_au8[minutesDigitRight_u8] | SEGMENT_DP_PIN, GPIO_PIN_SET);
			  HAL_GPIO_WritePin(DIGIT_GPIO_PORT, DIGIT_2_PIN, GPIO_PIN_SET);
		  }

		  // Digit 3
		  if (2U == currentDigit_u8)
		  {
			  uint8_t secondsDigitLeft_u8 = (uint8_t)((float)seconds_u8 / 10.0F);

			  HAL_GPIO_WritePin(SEGMENT_GPIO_PORT, SEGMENT_MASK, GPIO_PIN_RESET);
			  HAL_GPIO_WritePin(DIGIT_GPIO_PORT, DIGIT_2_PIN, GPIO_PIN_RESET);
			  HAL_GPIO_WritePin(SEGMENT_GPIO_PORT, segments_au8[secondsDigitLeft_u8], GPIO_PIN_SET);
			  HAL_GPIO_WritePin(DIGIT_GPIO_PORT, DIGIT_3_PIN, GPIO_PIN_SET);
		  }

		  // Digit 4
		  if (3U == currentDigit_u8)
		  {
			  uint8_t secondsDigitRight_u8 = seconds_u8 % 10U;

			  HAL_GPIO_WritePin(SEGMENT_GPIO_PORT, SEGMENT_MASK, GPIO_PIN_RESET);
			  HAL_GPIO_WritePin(DIGIT_GPIO_PORT, DIGIT_3_PIN, GPIO_PIN_RESET);
			  HAL_GPIO_WritePin(SEGMENT_GPIO_PORT, segments_au8[secondsDigitRight_u8], GPIO_PIN_SET);
			  HAL_GPIO_WritePin(DIGIT_GPIO_PORT, DIGIT_4_PIN, GPIO_PIN_SET);
		  }

	  }
	  /* hours:minutes */
	  else if (HOURS_MINUTES == clockMode_e)
	  {
		  // Digit 1
		  if (0U == currentDigit_u8)
		  {
			  uint8_t hoursDigitLeft_u8 = (uint8_t)((float)hours_u8 / 10.0F);

			  HAL_GPIO_WritePin(SEGMENT_GPIO_PORT, SEGMENT_MASK, GPIO_PIN_RESET);
			  HAL_GPIO_WritePin(DIGIT_GPIO_PORT, DIGIT_4_PIN, GPIO_PIN_RESET);
			  HAL_GPIO_WritePin(SEGMENT_GPIO_PORT, segments_au8[hoursDigitLeft_u8], GPIO_PIN_SET);
			  HAL_GPIO_WritePin(DIGIT_GPIO_PORT, DIGIT_1_PIN, GPIO_PIN_SET);
		  }

		  // Digit 2
		  if (1U == currentDigit_u8)
		  {
			  uint8_t hoursDigitRight_u8 = hours_u8 % 10U;

			  HAL_GPIO_WritePin(SEGMENT_GPIO_PORT, SEGMENT_MASK, GPIO_PIN_RESET);
			  HAL_GPIO_WritePin(DIGIT_GPIO_PORT, DIGIT_1_PIN, GPIO_PIN_RESET);
			  HAL_GPIO_WritePin(SEGMENT_GPIO_PORT, segments_au8[hoursDigitRight_u8] | SEGMENT_DP_PIN, GPIO_PIN_SET);
			  HAL_GPIO_WritePin(DIGIT_GPIO_PORT, DIGIT_2_PIN, GPIO_PIN_SET);
		  }

		  // Digit 3
		  if (2U == currentDigit_u8)
		  {
			  uint8_t minutesDigitLeft_u8 = (uint8_t)((float)minutes_u8 / 10.0F);

			  HAL_GPIO_WritePin(SEGMENT_GPIO_PORT, SEGMENT_MASK, GPIO_PIN_RESET);
			  HAL_GPIO_WritePin(DIGIT_GPIO_PORT, DIGIT_2_PIN, GPIO_PIN_RESET);
			  HAL_GPIO_WritePin(SEGMENT_GPIO_PORT, segments_au8[minutesDigitLeft_u8], GPIO_PIN_SET);
			  HAL_GPIO_WritePin(DIGIT_GPIO_PORT, DIGIT_3_PIN, GPIO_PIN_SET);
		  }

		  // Digit 4
		  if (3U == currentDigit_u8)
		  {
			  uint8_t minutesDigitRight_u8 = minutes_u8 % 10U;

			  HAL_GPIO_WritePin(SEGMENT_GPIO_PORT, SEGMENT_MASK, GPIO_PIN_RESET);
			  HAL_GPIO_WritePin(DIGIT_GPIO_PORT, DIGIT_3_PIN, GPIO_PIN_RESET);

			  HAL_GPIO_WritePin(SEGMENT_GPIO_PORT,
					                              (dotBlinkCounter_u16 < (RIGHT_DOT_BLINK_INTERVAL / 2U)) ?
					                                    segments_au8[minutesDigitRight_u8] : segments_au8[minutesDigitRight_u8] | SEGMENT_DP_PIN,
							                       GPIO_PIN_SET);

			  HAL_GPIO_WritePin(DIGIT_GPIO_PORT, DIGIT_4_PIN, GPIO_PIN_SET);

		  }
	  }

	  dotBlinkCounter_u16++;
	  if (dotBlinkCounter_u16 >= RIGHT_DOT_BLINK_INTERVAL)
	  {
		  dotBlinkCounter_u16 = 0U;
	  }

	  currentDigit_u8++;
	  if (currentDigit_u8 >= NUMBER_OF_DIGITS)
	  {
		  currentDigit_u8 = 0U;
	  }
}

/* USER CODE END 4 */

void Error_Handler(void)
{
  __disable_irq();
  while (1)
  {
  }
}
